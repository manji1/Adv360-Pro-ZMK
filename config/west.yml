## config/west.yml
```yaml
manifest:
  remotes:
    - name: zmkfirmware
      url-base: https://github.com/zmkfirmware
    - name: self
      url-base: https://github.com/manji1
  projects:
    - name: zmk
      remote: self
      revision: adv360-z3
      import: app/west.yml
  self:
    path: config
```
